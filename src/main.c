/*
 * DWM3001CDK Nearby Interaction protocol bring-up firmware
 *
 * This file deliberately keeps the proven DW3110 probe/configuration/test-TX
 * path from the user's working firmware, and adds:
 *   - QorvoNIService (QNIS) GATT service
 *   - Apple Nearby Interaction Service (ANIS) configuration characteristic
 *   - Apple/Qorvo NI application message framing (0x0A / 0x01 / 0x0B / 0x02 / 0x0C / 0x03)
 *   - BLE encryption request and reconnect/advertising handling
 *   - a separate QNIS session-control characteristic for local diagnostics
 *
 * IMPORTANT LIMITATION:
 * The accessory configuration bytes below are a captured Qorvo QANI reference
 * fixture, not a per-session value generated by the DWM3001 UWB middleware.
 * They are useful for exercising the BLE/GATT and message framing. The
 * proprietary Qorvo fira_niq_helper()/FiRa NI session layer is not in the
 * supplied project, so ni_start_session_from_apple_config() intentionally
 * returns -ENOTSUP. This firmware therefore DOES NOT claim that UWB ranging
 * has started and does not send the 0x02 "started" response. Do not describe
 * this build as a completed Apple NI ranging implementation.
 *
 * Message transport (as seen in Qorvo QANI logs):
 *   iPhone -> RX: 0x0A                       initialize / request config
 *   device -> TX: 0x01 + 37-byte config     accessory config response
 *   iPhone -> RX: 0x0B + Apple config       configure and start
 *   device -> TX: 0x02                       only after real UWB start succeeds
 *   iPhone -> RX: 0x0C                       stop
 *   device -> TX: 0x03                       stopped
 *
 * The static config fixture is a development aid only. Replace it with the
 * output of a real DWM3001-compatible NI/FiRa middleware implementation.
 */

#include <zephyr/kernel.h>
#include <zephyr/sys/printk.h>
#include <zephyr/sys/util.h>

#include <zephyr/bluetooth/bluetooth.h>
#include <zephyr/bluetooth/conn.h>
#include <zephyr/bluetooth/gatt.h>
#include <zephyr/bluetooth/hci.h>

#include <errno.h>
#include <stdbool.h>
#include <stddef.h>
#include <stdint.h>
#include <string.h>

#include "dw3000_hw.h"
#include "deca_probe_interface.h"
#include "deca_device_api.h"

/* -------------------------------------------------------------------------- */
/* Bluetooth UUIDs                                                            */
/*                                                                            */
/* BT_UUID_INIT_128() stores the 128-bit UUID in Bluetooth little-endian      */
/* octet order. These values are reversed from the human-readable UUIDs.      */
/* -------------------------------------------------------------------------- */

/* Qorvo Nearby Interaction Service: 2E938FD0-6A61-11ED-A1EB-0242AC120002 */
static struct bt_uuid_128 qnis_service_uuid = BT_UUID_INIT_128(
    0x02, 0x00, 0x12, 0xAC, 0x42, 0x02, 0xEB, 0xA1,
    0xED, 0x11, 0x61, 0x6A, 0xD0, 0x8F, 0x93, 0x2E);

/* QNIS session-control characteristic: 2E93941C-6A61-11ED-A1EB-0242AC120002 */
static struct bt_uuid_128 qnis_sc_uuid = BT_UUID_INIT_128(
    0x02, 0x00, 0x12, 0xAC, 0x42, 0x02, 0xEB, 0xA1,
    0xED, 0x11, 0x61, 0x6A, 0x1C, 0x94, 0x93, 0x2E);

/* QNIS receive characteristic: 2E93998A-6A61-11ED-A1EB-0242AC120002 */
static struct bt_uuid_128 qnis_rx_uuid = BT_UUID_INIT_128(
    0x02, 0x00, 0x12, 0xAC, 0x42, 0x02, 0xEB, 0xA1,
    0xED, 0x11, 0x61, 0x6A, 0x8A, 0x99, 0x93, 0x2E);

/* QNIS transmit characteristic: 2E939AF2-6A61-11ED-A1EB-0242AC120002 */
static struct bt_uuid_128 qnis_tx_uuid = BT_UUID_INIT_128(
    0x02, 0x00, 0x12, 0xAC, 0x42, 0x02, 0xEB, 0xA1,
    0xED, 0x11, 0x61, 0x6A, 0xF2, 0x9A, 0x93, 0x2E);

/* Apple Nearby Interaction Service: 48FE3E40-0817-4BB2-8633-3073689C2DBA */
static struct bt_uuid_128 anis_service_uuid = BT_UUID_INIT_128(
    0xBA, 0x2D, 0x9C, 0x68, 0x73, 0x30, 0x33, 0x86,
    0xB2, 0x4B, 0x17, 0x08, 0x40, 0x3E, 0xFE, 0x48);

/* Apple Accessory Single Configuration Data: 95E8D9D5-D8EF-4721-9A4E-807375F53328 */
static struct bt_uuid_128 anis_accessory_data_uuid = BT_UUID_INIT_128(
    0x28, 0x33, 0xF5, 0x75, 0x73, 0x80, 0x4E, 0x9A,
    0x21, 0x47, 0xEF, 0xD8, 0xD5, 0xD9, 0xE8, 0x95);

#define DEVICE_NAME                 "DWM3001-TRACKER"
#define UWB_TXFRS_MASK              DWT_INT_TXFRS_BIT_MASK
#define UWB_TEST_PACKET_LEN         7U
#define NI_APP_MAX_CONFIG_LEN       64U
#define NI_CONFIG_RESPONSE_LEN      38U
#define NI_CONFIG_DATA_LEN          (NI_CONFIG_RESPONSE_LEN - 1U)
#define NI_CONFIG_NOTIFY_RETRY_MS   50U
#define NI_CONFIG_NOTIFY_RETRIES    30U

/* QNIS application message IDs. */
#define NI_MSG_ACCESSORY_CONFIG     0x01U
#define NI_MSG_UWB_STARTED          0x02U
#define NI_MSG_UWB_STOPPED          0x03U
#define NI_MSG_INITIALIZE           0x0AU
#define NI_MSG_CONFIGURE_AND_START  0x0BU
#define NI_MSG_STOP                 0x0CU

/* Local-only diagnostic commands written to the session-control UUID.
 * These are development extensions, not claimed standard NI messages.
 */
#define DBG_CMD_PING                0x01U
#define DBG_CMD_STATUS              0x02U
#define DBG_CMD_UWB_TEST_TX         0x03U
#define DBG_EVT_PING_ACK            0x81U
#define DBG_EVT_STATUS              0x82U
#define DBG_EVT_UWB_TX              0x83U

/* -------------------------------------------------------------------------- */
/* Accessory configuration fixture                                           */
/* -------------------------------------------------------------------------- */

/*
 * This 37-byte Accessory Configuration Data body is transcribed from a Qorvo
 * QANI interoperability log (the log's 38-byte notification included the
 * leading 0x01 message ID). It has the standard 1.0 outer format:
 *   major=1, minor=0, update-rate=20, RFU=10 zero bytes, UWB data length=21.
 *
 * It is NOT generated for this board at runtime and is not safe as a final
 * production/session-unique configuration. Its purpose here is to exercise
 * the BLE protocol path until real middleware is integrated.
 */
/* Qorvo app expects the message ID in the notification, but not in ANIS. */
static const uint8_t accessory_config_response[NI_CONFIG_RESPONSE_LEN] = {
    NI_MSG_ACCESSORY_CONFIG,
    /* The 37-byte Apple Accessory Configuration Data body. */
    0x01, 0x00, 0x00, 0x00, 0x14,
    0x00, 0x00, 0x00, 0x00, 0x00,
    0x00, 0x00, 0x00, 0x00, 0x00,
    0x15,
    0x01, 0x00, 0x01, 0x00, 0x3F, 0xF5, 0xE3,
    0x00, 0xB8, 0x0B, 0x00, 0x00, 0x00, 0x00,
    0x01, 0x01, 0x01, 0x48, 0x7A, 0x19, 0x00
};

/* -------------------------------------------------------------------------- */
/* Runtime state                                                              */
/* -------------------------------------------------------------------------- */

enum ni_state {
    NI_STATE_IDLE = 0,
    NI_STATE_CONFIG_PENDING,
    NI_STATE_CONFIG_SENT,
    NI_STATE_APP_CONFIG_RECEIVED,
    NI_STATE_START_UNAVAILABLE,
    NI_STATE_RUNNING,
};

static volatile uint8_t tracker_status;
static bool uwb_ready;
static bool uwb_session_active;
static enum ni_state ni_current_state = NI_STATE_IDLE;
static uint8_t qnis_sc_value;

static uint8_t apple_shareable_config[NI_APP_MAX_CONFIG_LEN];
static size_t apple_shareable_config_len;

static struct bt_conn *active_conn;
static uint8_t config_notify_retries;
static struct bt_conn *debug_tx_conn;

/* QNIS TX value is attribute 6: service(0), SC decl/value(1/2),
 * RX decl/value(3/4), TX decl/value(5/6), CCC(7).
 */
#define QNIS_TX_VALUE_ATTR_INDEX 6

/* Apple ANIS service value attribute is index 2. */

/* -------------------------------------------------------------------------- */
/* Driver initialization and proven test transmit                            */
/* -------------------------------------------------------------------------- */

static int initialize_uwb_radio(void)
{
    printk("\n[UWB] Initializing DW3110 radio...\n");

    int ret = dwt_initialise(0);
    if (ret != DWT_SUCCESS) {
        printk("[UWB] Radio initialization failed: %d\n", ret);
        return -1;
    }

    printk("[UWB] Applying known-good channel 5 test configuration...\n");

    static dwt_config_t config = {
        .chan           = 5,
        .txPreambLength = DWT_PLEN_128,
        .rxPAC          = DWT_PAC8,
        .txCode         = 9,
        .rxCode         = 9,
        .sfdType        = DWT_SFD_IEEE_4Z,
        .dataRate       = DWT_BR_6M8,
        .phrMode        = DWT_PHRMODE_STD,
        .phrRate        = DWT_PHRRATE_STD,
        .sfdTO          = 0,
        .stsMode        = DWT_STS_MODE_OFF,
        .stsLength      = DWT_STS_LEN_64,
        .pdoaMode       = DWT_PDOA_M0
    };

    ret = dwt_configure(&config);
    if (ret != DWT_SUCCESS) {
        printk("[UWB] Radio configuration failed: %d\n", ret);
        return -2;
    }

    printk("[UWB] Test radio configuration applied.\n");
    printk("[UWB] NOTE: STS is OFF in this test profile; this is not the NI profile.\n");
    return 0;
}

static int transmit_uwb_test_packet(void)
{
    if (!uwb_ready) {
        printk("[UWB] ERROR: Radio is not ready.\n");
        return -ENODEV;
    }

    uint8_t packet[UWB_TEST_PACKET_LEN] = {
        'D', 'W', 'M', '3', '0', '0', '1'
    };

    printk("\n[UWB] Preparing known-good test transmission...\n");

    dwt_writesysstatuslo(UWB_TXFRS_MASK);

    int ret = dwt_writetxdata(sizeof(packet), packet, 0);
    if (ret != DWT_SUCCESS) {
        printk("[UWB] Failed to write TX data: %d\n", ret);
        return -EIO;
    }

    /* The DW3110 adds the two-byte PHY CRC. */
    dwt_writetxfctrl(sizeof(packet) + 2U, 0, 0);

    printk("[UWB] Starting immediate transmission...\n");
    ret = dwt_starttx(DWT_START_TX_IMMEDIATE);
    if (ret != DWT_SUCCESS) {
        printk("[UWB] Transmission could not start: %d\n", ret);
        return -EIO;
    }

    for (int i = 0; i < 100; i++) {
        if ((dwt_readsysstatuslo() & UWB_TXFRS_MASK) != 0U) {
            dwt_writesysstatuslo(UWB_TXFRS_MASK);
            printk("[UWB] SUCCESS: Test transmission completed.\n");
            return 0;
        }
        k_msleep(1);
    }

    printk("[UWB] ERROR: Test transmission timed out.\n");
    return -ETIMEDOUT;
}

/* -------------------------------------------------------------------------- */
/* NI middleware boundary                                                     */
/* -------------------------------------------------------------------------- */

/*
 * This is the exact hand-off point where a real FiRa NI middleware stack
 * must consume Apple's shareable configuration bytes and configure the DW3110
 * (including STS, session/MAC parameters, ranging schedule, and secure ranging
 * state). The supplied low-level driver exposes radio primitives, not that
 * Apple-compatible session manager.
 *
 * Do not replace this with a guessed dwt_config_t or raw test transmission:
 * that would not implement Apple's secure NI ranging session.
 */
static int ni_start_session_from_apple_config(const uint8_t *config, size_t len)
{
    ARG_UNUSED(config);
    ARG_UNUSED(len);

    printk("[NI] Apple configuration received (%u bytes).\n",
           (unsigned int)len);
    printk("[NI] No FiRa NI middleware is present in this project.\n");
    printk("[NI] Refusing to report a false UWB session start.\n");
    return -ENOTSUP;
}

static int ni_stop_session(void)
{
    if (uwb_session_active) {
        dwt_forcetrxoff();
        uwb_session_active = false;
    }

    ni_current_state = NI_STATE_IDLE;
    apple_shareable_config_len = 0U;
    memset(apple_shareable_config, 0, sizeof(apple_shareable_config));
    return 0;
}

/* -------------------------------------------------------------------------- */
/* QNIS and Apple ANIS GATT services                                            */
/* -------------------------------------------------------------------------- */

/* GATT callback prototypes are needed before the static service declarations. */
static ssize_t read_qnis_sc(struct bt_conn *conn,
                            const struct bt_gatt_attr *attr,
                            void *buf, uint16_t len, uint16_t offset);
static ssize_t write_qnis_sc(struct bt_conn *conn,
                             const struct bt_gatt_attr *attr,
                             const void *buf, uint16_t len,
                             uint16_t offset, uint8_t flags);
static ssize_t read_anis_accessory_data(struct bt_conn *conn,
                                        const struct bt_gatt_attr *attr,
                                        void *buf, uint16_t len,
                                        uint16_t offset);
static ssize_t write_qnis_rx(struct bt_conn *conn,
                             const struct bt_gatt_attr *attr,
                             const void *buf, uint16_t len,
                             uint16_t offset, uint8_t flags);

/* -------------------------------------------------------------------------- */
/* QNIS and Apple ANIS GATT services                                            */
/* -------------------------------------------------------------------------- */

BT_GATT_SERVICE_DEFINE(
    qnis_service,
    BT_GATT_PRIMARY_SERVICE(&qnis_service_uuid.uuid),

    /* Session-control channel: simple encrypted read/write diagnostic byte. */
    BT_GATT_CHARACTERISTIC(
        &qnis_sc_uuid.uuid,
        BT_GATT_CHRC_READ | BT_GATT_CHRC_WRITE,
        BT_GATT_PERM_READ_ENCRYPT | BT_GATT_PERM_WRITE_ENCRYPT,
        read_qnis_sc,
        write_qnis_sc,
        NULL
    ),

    /* RX: iPhone writes application messages (0x0A/0x0B/0x0C). */
    BT_GATT_CHARACTERISTIC(
        &qnis_rx_uuid.uuid,
        BT_GATT_CHRC_WRITE | BT_GATT_CHRC_WRITE_WITHOUT_RESP,
        BT_GATT_PERM_WRITE_ENCRYPT,
        NULL,
        write_qnis_rx,
        NULL
    ),

    /* TX: accessory sends notification messages to the iPhone. */
    BT_GATT_CHARACTERISTIC(
        &qnis_tx_uuid.uuid,
        BT_GATT_CHRC_NOTIFY,
        BT_GATT_PERM_NONE,
        NULL,
        NULL,
        NULL
    ),
    BT_GATT_CCC(NULL,
                BT_GATT_PERM_READ_ENCRYPT | BT_GATT_PERM_WRITE_ENCRYPT)
);

BT_GATT_SERVICE_DEFINE(
    anis_service,
    BT_GATT_PRIMARY_SERVICE(&anis_service_uuid.uuid),
    BT_GATT_CHARACTERISTIC(
        &anis_accessory_data_uuid.uuid,
        BT_GATT_CHRC_READ,
        BT_GATT_PERM_READ_ENCRYPT,
        read_anis_accessory_data,
        NULL,
        NULL
    )
);


static int qnis_notify(struct bt_conn *conn, const uint8_t *data, uint16_t len)
{
    if (conn == NULL) {
        return -ENOTCONN;
    }

    return bt_gatt_notify(conn,
                          &qnis_service.attrs[QNIS_TX_VALUE_ATTR_INDEX],
                          data, len);
}

static void config_notify_work_handler(struct k_work *work)
{
    ARG_UNUSED(work);

    if (active_conn == NULL || ni_current_state != NI_STATE_CONFIG_PENDING) {
        return;
    }

    /* The Qorvo app may enable TX notifications immediately after writing
     * 0x0A. Retry briefly so the response is not lost to that ordering race.
     */
    if (!bt_gatt_is_subscribed(active_conn,
                               &qnis_service.attrs[QNIS_TX_VALUE_ATTR_INDEX],
                               BT_GATT_CCC_NOTIFY)) {
        if (config_notify_retries++ < NI_CONFIG_NOTIFY_RETRIES) {
            k_work_reschedule(&config_notify_work,
                              K_MSEC(NI_CONFIG_NOTIFY_RETRY_MS));
        } else {
            ni_current_state = NI_STATE_IDLE;
            printk("[NI] Config response not sent: TX notifications were not enabled.\n");
        }
        return;
    }

    int ret = qnis_notify(active_conn, accessory_config_response,
                          sizeof(accessory_config_response));
    if (ret == 0) {
        ni_current_state = NI_STATE_CONFIG_SENT;
        printk("[NI] Sent Qorvo reference accessory-config response (%u bytes).\n",
               (unsigned int)sizeof(accessory_config_response));
        printk("[NI] This is a BLE test fixture, not a session-generated UWB config.\n");
    } else if (config_notify_retries++ < NI_CONFIG_NOTIFY_RETRIES) {
        printk("[NI] Config notify retry after error %d.\n", ret);
        k_work_reschedule(&config_notify_work,
                          K_MSEC(NI_CONFIG_NOTIFY_RETRY_MS));
    } else {
        ni_current_state = NI_STATE_IDLE;
        printk("[NI] Config notify failed after retries: %d\n", ret);
    }
}

K_WORK_DELAYABLE_DEFINE(config_notify_work, config_notify_work_handler);

static void uwb_test_work_handler(struct k_work *work)
{
    ARG_UNUSED(work);

    int ret = transmit_uwb_test_packet();
    uint8_t event[2] = { DBG_EVT_UWB_TX, (ret == 0) ? 1U : 0U };

    if (debug_tx_conn != NULL) {
        (void)qnis_notify(debug_tx_conn, event, sizeof(event));
        bt_conn_unref(debug_tx_conn);
        debug_tx_conn = NULL;
    }
}

K_WORK_DEFINE(uwb_test_work, uwb_test_work_handler);


/* -------------------------------------------------------------------------- */
/* GATT read/write callbacks                                                   */
/* -------------------------------------------------------------------------- */

static ssize_t read_qnis_sc(struct bt_conn *conn,
                            const struct bt_gatt_attr *attr,
                            void *buf, uint16_t len, uint16_t offset)
{
    return bt_gatt_attr_read(conn, attr, buf, len, offset,
                             &qnis_sc_value, sizeof(qnis_sc_value));
}

static ssize_t write_qnis_sc(struct bt_conn *conn,
                             const struct bt_gatt_attr *attr,
                             const void *buf, uint16_t len,
                             uint16_t offset, uint8_t flags)
{
    ARG_UNUSED(attr);
    ARG_UNUSED(flags);

    if (offset != 0U) {
        return BT_GATT_ERR(BT_ATT_ERR_INVALID_OFFSET);
    }
    if (len != 1U) {
        return BT_GATT_ERR(BT_ATT_ERR_INVALID_ATTRIBUTE_LEN);
    }

    uint8_t command = ((const uint8_t *)buf)[0];
    qnis_sc_value = command;

    printk("\n[BLE][SC] Diagnostic control 0x%02X\n", command);

    switch (command) {
    case DBG_CMD_PING: {
        uint8_t event[2] = { DBG_EVT_PING_ACK, tracker_status };
        (void)qnis_notify(conn, event, sizeof(event));
        break;
    }
    case DBG_CMD_STATUS: {
        uint8_t event[2] = { DBG_EVT_STATUS, tracker_status };
        (void)qnis_notify(conn, event, sizeof(event));
        break;
    }
    case DBG_CMD_UWB_TEST_TX:
        if (debug_tx_conn != NULL) {
            return BT_GATT_ERR(BT_ATT_ERR_INSUFFICIENT_RESOURCES);
        }
        debug_tx_conn = bt_conn_ref(conn);
        if (k_work_submit(&uwb_test_work) < 0) {
            bt_conn_unref(debug_tx_conn);
            debug_tx_conn = NULL;
            return BT_GATT_ERR(BT_ATT_ERR_UNLIKELY);
        }
        break;
    default:
        printk("[BLE][SC] Unknown diagnostic command.\n");
        break;
    }

    return len;
}

static ssize_t read_anis_accessory_data(struct bt_conn *conn,
                                        const struct bt_gatt_attr *attr,
                                        void *buf, uint16_t len,
                                        uint16_t offset)
{
    return bt_gatt_attr_read(conn, attr, buf, len, offset,
                             &accessory_config_response[1],
                             NI_CONFIG_DATA_LEN);
}

static ssize_t write_qnis_rx(struct bt_conn *conn,
                             const struct bt_gatt_attr *attr,
                             const void *buf, uint16_t len,
                             uint16_t offset, uint8_t flags)
{
    ARG_UNUSED(attr);
    ARG_UNUSED(flags);

    if (offset != 0U) {
        return BT_GATT_ERR(BT_ATT_ERR_INVALID_OFFSET);
    }
    if (len < 1U) {
        return BT_GATT_ERR(BT_ATT_ERR_INVALID_ATTRIBUTE_LEN);
    }

    const uint8_t *packet = (const uint8_t *)buf;
    const uint8_t message_id = packet[0];

    printk("\n[NI] RX write: %u bytes, message 0x%02X\n",
           (unsigned int)len, message_id);

    switch (message_id) {
    case NI_MSG_INITIALIZE:
        if (len != 1U) {
            printk("[NI] Initialize message must be exactly one byte.\n");
            return BT_GATT_ERR(BT_ATT_ERR_INVALID_ATTRIBUTE_LEN);
        }
        printk("[NI] Initialize: accessory configuration requested.\n");
        ni_current_state = NI_STATE_CONFIG_PENDING;
        config_notify_retries = 0U;
        k_work_reschedule(&config_notify_work, K_MSEC(150));
        break;

    case NI_MSG_CONFIGURE_AND_START: {
        size_t config_len = (size_t)len - 1U;

        if (config_len == 0U || config_len > sizeof(apple_shareable_config)) {
            printk("[NI] Invalid Apple shareable-config length: %u\n",
                   (unsigned int)config_len);
            return BT_GATT_ERR(BT_ATT_ERR_INVALID_ATTRIBUTE_LEN);
        }

        memcpy(apple_shareable_config, &packet[1], config_len);
        apple_shareable_config_len = config_len;
        ni_current_state = NI_STATE_APP_CONFIG_RECEIVED;

        printk("[NI] Apple shareable configuration stored unchanged (%u bytes); payload not printed.\n",
               (unsigned int)apple_shareable_config_len);

        int ret = ni_start_session_from_apple_config(
            apple_shareable_config, apple_shareable_config_len);

        if (ret == 0) {
            /* Only acknowledge 0x02 if the real UWB session actually starts. */
            uint8_t response = NI_MSG_UWB_STARTED;
            uwb_session_active = true;
            ni_current_state = NI_STATE_RUNNING;
            (void)qnis_notify(conn, &response, sizeof(response));
            printk("[NI] UWB session started.\n");
        } else {
            ni_current_state = NI_STATE_START_UNAVAILABLE;
            printk("[NI] Session not started (middleware hook returned %d).\n", ret);
        }
        break;
    }

    case NI_MSG_STOP: {
        int ret = ni_stop_session();
        if (ret == 0) {
            uint8_t response = NI_MSG_UWB_STOPPED;
            (void)qnis_notify(conn, &response, sizeof(response));
            printk("[NI] Stop handled; sent 0x03.\n");
        } else {
            printk("[NI] Stop failed: %d\n", ret);
        }
        break;
    }

    case 0xF0:
        /* Test-only extension: run the already-proven single UWB TX. */
        if (debug_tx_conn != NULL) {
            return BT_GATT_ERR(BT_ATT_ERR_INSUFFICIENT_RESOURCES);
        }
        debug_tx_conn = bt_conn_ref(conn);
        if (k_work_submit(&uwb_test_work) < 0) {
            bt_conn_unref(debug_tx_conn);
            debug_tx_conn = NULL;
            return BT_GATT_ERR(BT_ATT_ERR_UNLIKELY);
        }
        break;

    default:
        printk("[NI] Unknown RX message 0x%02X.\n", message_id);
        break;
    }

    return len;
}


/* -------------------------------------------------------------------------- */
/* Connection and advertising management                                      */
/* -------------------------------------------------------------------------- */

static const struct bt_data advertising_data[] = {
    BT_DATA_BYTES(BT_DATA_FLAGS,
                  (BT_LE_AD_GENERAL | BT_LE_AD_NO_BREDR)),
    BT_DATA_BYTES(BT_DATA_UUID128_ALL,
                  0x02, 0x00, 0x12, 0xAC, 0x42, 0x02, 0xEB, 0xA1,
                  0xED, 0x11, 0x61, 0x6A, 0xD0, 0x8F, 0x93, 0x2E)
};

static const struct bt_data scan_response[] = {
    BT_DATA(BT_DATA_NAME_COMPLETE, DEVICE_NAME, sizeof(DEVICE_NAME) - 1U)
};

static int start_advertising(void)
{
    int ret = bt_le_adv_start(BT_LE_ADV_CONN_FAST_1,
                              advertising_data,
                              ARRAY_SIZE(advertising_data),
                              scan_response,
                              ARRAY_SIZE(scan_response));
    if (ret == 0) {
        printk("[BLE] Advertising as %s\n", DEVICE_NAME);
    } else {
        printk("[BLE] Advertising start failed: %d\n", ret);
    }
    return ret;
}

static void connected(struct bt_conn *conn, uint8_t conn_err)
{
    if (conn_err != 0U) {
        printk("[BLE] Connection failed: 0x%02X\n", conn_err);
        return;
    }

    printk("[BLE] Connected. Requesting encrypted link for QNIS/ANIS.\n");

    if (active_conn != NULL) {
        bt_conn_unref(active_conn);
    }
    active_conn = bt_conn_ref(conn);

    int ret = bt_conn_set_security(conn, BT_SECURITY_L2);
    if (ret != 0) {
        printk("[BLE] Security request failed: %d\n", ret);
    }
}

static void disconnected(struct bt_conn *conn, uint8_t reason)
{
    printk("[BLE] Disconnected (reason 0x%02X).\n", reason);

    if (active_conn == conn) {
        k_work_cancel_delayable(&config_notify_work);
        active_conn = NULL;
        bt_conn_unref(conn);
    }

    /* If a test-TX work item owns a connection reference, it releases that
     * reference itself when it completes. Do not race the worker here.
     */

    (void)ni_stop_session();
    ni_current_state = NI_STATE_IDLE;

    /* Legacy connectable advertising stops while connected. Restart it. */
    (void)start_advertising();
}

static void security_changed(struct bt_conn *conn, bt_security_t level,
                             enum bt_security_err err)
{
    ARG_UNUSED(conn);
    if (err == BT_SECURITY_ERR_SUCCESS) {
        printk("[BLE] Link security established (level %u).\n",
               (unsigned int)level);
    } else {
        printk("[BLE] Link security failed (level %u, error %d).\n",
               (unsigned int)level, (int)err);
    }
}

BT_CONN_CB_DEFINE(connection_callbacks) = {
    .connected = connected,
    .disconnected = disconnected,
    .security_changed = security_changed,
};

/* -------------------------------------------------------------------------- */
/* Main                                                                        */
/* -------------------------------------------------------------------------- */

int main(void)
{
    printk("\n============================================\n");
    printk("   DWM3001 NI BLE / DW3110 BRING-UP FIRMWARE\n");
    printk("============================================\n");

    printk("\n[1] Initializing DW3110 hardware...\n");

    int ret = dw3000_hw_init();
    if (ret != 0) {
        printk("[ERROR] UWB hardware initialization: %d\n", ret);
        while (1) {
            k_sleep(K_SECONDS(2));
        }
    }

    dw3000_hw_reset();
    k_msleep(10);

    int32_t probe_result =
        dwt_probe((struct dwt_probe_s *)&dw3000_probe_interf);
    if (probe_result != DWT_SUCCESS) {
        printk("[ERROR] DW3110 identification failed.\n");
        while (1) {
            k_sleep(K_SECONDS(2));
        }
    }

    uint32_t device_id = dwt_readdevid();
    printk("[SUCCESS] DW3110 detected: 0x%08X\n", (unsigned int)device_id);

    ret = initialize_uwb_radio();
    if (ret == 0) {
        uwb_ready = true;
        tracker_status = 1U;
        printk("[SUCCESS] DW3110 test radio is ready.\n");
    } else {
        uwb_ready = false;
        tracker_status = 0U;
        printk("[WARNING] DW3110 test radio unavailable: %d\n", ret);
    }

    printk("\n[2] Initializing Bluetooth LE...\n");
    ret = bt_enable(NULL);
    if (ret != 0) {
        printk("[ERROR] Bluetooth initialization failed: %d\n", ret);
        while (1) {
            k_sleep(K_SECONDS(2));
        }
    }

    printk("[SUCCESS] Bluetooth initialized.\n");
    printk("[BLE] QNIS service: 2E938FD0-6A61-11ED-A1EB-0242AC120002\n");
    printk("[BLE] ANIS service: 48FE3E40-0817-4BB2-8633-3073689C2DBA\n");
    printk("[BLE] RX writes are encrypted; accept pairing on the iPhone.\n");

    printk("\n[3] Starting BLE advertising...\n");
    ret = start_advertising();
    if (ret != 0) {
        printk("[ERROR] BLE advertising failed: %d\n", ret);
        while (1) {
            k_sleep(K_SECONDS(2));
        }
    }

    printk("\n[NI] Supported BLE message IDs:\n");
    printk("     0x0A initialize -> 0x01 + config fixture\n");
    printk("     0x0B configure/start -> stored; UWB middleware unavailable\n");
    printk("     0x0C stop -> 0x03\n");
    printk("[DEBUG] Write 0x01/0x02/0x03 to SC for ping/status/test TX.\n");
    printk("[DEBUG] Or write 0xF0 to RX for the test TX extension.\n");
    printk("\n============================================\n");
    printk("     BLE + NI PROTOCOL BRING-UP READY\n");
    printk("============================================\n");

    while (1) {
        k_sleep(K_SECONDS(10));
    }

    return 0;
}
